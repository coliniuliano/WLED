#include "wled.h"

#ifdef ARDUINO_ARCH_ESP32
#include <esp_attr.h>
#include <esp_system.h>
#include <atomic>

// AI: below section was generated by an AI
// See netlog.h for what this is and why. Storage is RTC slow memory: 192 entries of 8
// bytes plus a header, about 1.5 KB of the 8 KB available, and RTC_NOINIT keeps the
// loader from zeroing it on a software reset. A magic word and bounds check guard
// against a power-up pattern or a layout change masquerading as a valid log.
//
// Two tasks write here: the Arduino WiFi event task and the main loop. A spin lock on an
// atomic flag covers the few instructions of an insert; contention is rare and a mutex
// would be heavier than the work it protects.

struct NetlogEntry {
  uint32_t ms;
  uint8_t  boot;
  uint8_t  ev;
  uint8_t  a;
  int8_t   b;
};

static constexpr size_t   NETLOG_SIZE  = 192;
static constexpr uint32_t NETLOG_MAGIC = 0x4E4C4F47; // "NLOG"

struct NetlogStore {
  uint32_t    magic;
  uint16_t    head;    // next slot to write
  uint16_t    count;   // valid entries, at most NETLOG_SIZE
  uint8_t     boot;    // increments on every boot, wraps
  uint8_t     pad[3];
  NetlogEntry e[NETLOG_SIZE];
};

static RTC_NOINIT_ATTR NetlogStore netlog;
static std::atomic_flag netlogLock = ATOMIC_FLAG_INIT;

void netlogInit()
{
  if (netlog.magic != NETLOG_MAGIC || netlog.head >= NETLOG_SIZE || netlog.count > NETLOG_SIZE) {
    memset(&netlog, 0, sizeof(netlog));
    netlog.magic = NETLOG_MAGIC;
  }
  netlog.boot++;
  netlogAdd(NL_BOOT, (uint8_t)esp_reset_reason());
}

// A retry loop with nothing changing (attempt, NO_AP_FOUND, attempt, NO_AP_FOUND ...)
// would otherwise push the one interesting entry -- what happened before the loop
// started -- out of the ring in minutes. So a repeating pattern of up to NETLOG_PERIOD
// entries is written NETLOG_REPEATS times in full, then only every NETLOG_SAMPLE-th
// repetition; the first different entry resets the compression.
static constexpr uint8_t NETLOG_PERIOD = 2, NETLOG_REPEATS = 3, NETLOG_SAMPLE = 30;
static uint8_t  recent[NETLOG_PERIOD][3];   // the last NETLOG_PERIOD entries (ev, a, b)
static uint8_t  recentPos = 0;
static uint16_t repeats = 0;

static bool netlogSuppress(uint8_t ev, uint8_t a, int8_t b)
{
  uint8_t& slotEv = recent[recentPos][0];
  const bool same = slotEv == ev && recent[recentPos][1] == a && recent[recentPos][2] == (uint8_t)b;
  if (!same) { repeats = 0; slotEv = ev; recent[recentPos][1] = a; recent[recentPos][2] = (uint8_t)b; }
  recentPos = (recentPos + 1) % NETLOG_PERIOD;
  if (!same) return false;
  if (recentPos == 0) repeats++;                          // one full period repeated
  return repeats >= NETLOG_REPEATS && (repeats % NETLOG_SAMPLE) != 0;
}

void netlogAdd(uint8_t ev, uint8_t a, int8_t b)
{
  while (netlogLock.test_and_set(std::memory_order_acquire)) taskYIELD();
  if (netlogSuppress(ev, a, b)) { netlogLock.clear(std::memory_order_release); return; }
  NetlogEntry& e = netlog.e[netlog.head];
  e.ms = millis(); e.boot = netlog.boot; e.ev = ev; e.a = a; e.b = b;
  netlog.head = (netlog.head + 1) % NETLOG_SIZE;
  if (netlog.count < NETLOG_SIZE) netlog.count++;
  netlogLock.clear(std::memory_order_release);
}

void netlogClear()
{
  while (netlogLock.test_and_set(std::memory_order_acquire)) taskYIELD();
  netlog.head = 0; netlog.count = 0;
  netlogLock.clear(std::memory_order_release);
}

static const char* resetReasonName(uint8_t r)
{
  switch ((esp_reset_reason_t)r) {
    case ESP_RST_POWERON:   return "power-on";
    case ESP_RST_EXT:       return "external pin";
    case ESP_RST_SW:        return "software";
    case ESP_RST_PANIC:     return "panic";
    case ESP_RST_INT_WDT:   return "interrupt watchdog";
    case ESP_RST_TASK_WDT:  return "task watchdog";
    case ESP_RST_WDT:       return "other watchdog";
    case ESP_RST_DEEPSLEEP: return "deep sleep";
    case ESP_RST_BROWNOUT:  return "brownout";
    case ESP_RST_SDIO:      return "SDIO";
    case ESP_RST_USB:       return "USB";
    case ESP_RST_JTAG:      return "JTAG";
    case ESP_RST_EFUSE:     return "efuse error";
    case ESP_RST_PWR_GLITCH:return "power glitch";
    case ESP_RST_CPU_LOCKUP:return "CPU lockup";
    default:                return "unknown";
  }
}

static const char* apReasonName(uint8_t r)
{
  switch ((NetlogApReason)r) {
    case AP_REASON_BOOT:        return "no WiFi at boot";
    case AP_REASON_WIFI_LOST:   return "WiFi lost";
    case AP_REASON_NO_NETWORK:  return "no network at all";
    case AP_REASON_REQUESTED:   return "requested";
    case AP_REASON_ALWAYS:      return "AP always";
    case AP_REASON_WIFI_UP:     return "WiFi up";
    case AP_REASON_WINDOW_OVER: return "window over";
    default:                    return "upstream logic";
  }
}

// One line per entry: boot number, uptime, event, detail. Oldest first.
void netlogPrint(Print& out)
{
  out.printf_P(PSTR("netlog: %u entries, current boot #%u. Earlier boots survive a reset but not a power cycle.\n"
                    "Driver AP lines appear only while the firmware counts the AP as open; a stop with no start after it is the AP going away unnoticed.\n"
                    "A repeating pattern (retry loop) is written three times in full, then every 30th repetition.\n"
                    "boot  uptime         event\n"), (unsigned)netlog.count, (unsigned)netlog.boot);
  for (size_t i = 0; i < netlog.count; i++) {
    const NetlogEntry e = netlog.e[(netlog.head + NETLOG_SIZE - netlog.count + i) % NETLOG_SIZE];
    const uint32_t s = e.ms / 1000;
    out.printf_P(PSTR("%3u   %3u:%02u:%02u.%03u  "), (unsigned)e.boot, (unsigned)(s / 3600), (unsigned)(s / 60 % 60), (unsigned)(s % 60), (unsigned)(e.ms % 1000));
    switch (e.ev) {
      case NL_BOOT:                   out.printf_P(PSTR("boot (%s reset)"), resetReasonName(e.a)); break;
      case NL_STA_CONNECTED:          out.print(F("WiFi associated")); break;
      case NL_STA_DISCONNECTED:       out.printf_P(PSTR("WiFi disconnected: reason %u (%s), rssi %d"), (unsigned)e.a, WiFi.STA.disconnectReasonName((wifi_err_reason_t)e.a), (int)e.b); break;
      case NL_STA_GOT_IP:             out.printf_P(PSTR("WiFi got IP (.%u)"), (unsigned)e.a); break;
      case NL_STA_LOST_IP:            out.print(F("WiFi lost IP")); break;
      case NL_AP_START:               out.printf_P(PSTR("driver: AP started (firmware flag %u)"), (unsigned)e.a); break;
      case NL_AP_STOP:                out.printf_P(PSTR("driver: AP stopped (firmware flag %u)%s"), (unsigned)e.a, e.a ? " <-- firmware still counts the AP as open" : ""); break;
      case NL_AP_CLIENT_CONNECTED:    out.printf_P(PSTR("AP client joined (%u)"), (unsigned)e.a); break;
      case NL_AP_CLIENT_DISCONNECTED: out.printf_P(PSTR("AP client left (%u)"), (unsigned)e.a); break;
      case NL_ETH_CONNECTED:          out.print(F("Ethernet link up")); break;
      case NL_ETH_GOT_IP:             out.printf_P(PSTR("Ethernet got IP (.%u%s)"), (unsigned)e.a, e.b ? ", link-local" : ""); break;
      case NL_ETH_DISCONNECTED:       out.print(F("Ethernet link down")); break;
      case NL_INIT_CONNECTION:        out.printf_P(PSTR("WiFi connection attempt (AP %s)"), e.a ? "open" : "closed");
                                      if (e.b > 0) out.printf_P(PSTR(", TX power %.1f dBm"), e.b / 4.0f);
                                      break;
      case NL_AP_OPEN:                out.printf_P(PSTR("AP opened on channel %u (%s)"), (unsigned)e.a, apReasonName(e.b)); break;
      case NL_AP_CLOSE:               out.printf_P(PSTR("AP closed (%s)"), apReasonName(e.b)); break;
      case NL_TX_POWER:               out.printf_P(PSTR("TX power set to %u (%.1f dBm)"), (unsigned)e.a, e.a / 4.0f);
                                      if (e.b < 0) out.printf_P(PSTR(", router rssi %d"), (int)e.b);
                                      break;
      case NL_SLEEP:                  out.print(e.a ? F("modem sleep on") : F("modem sleep off")); break;
      default:                        out.printf_P(PSTR("event %u (%u, %d)"), (unsigned)e.ev, (unsigned)e.a, (int)e.b); break;
    }
    out.print('\n');
  }
}
// AI: end
#endif
