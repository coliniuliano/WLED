#include "wled.h"

#ifdef WLED_AP_RESCUE
// AI: below section was generated by an AI
/*
  Network policy for a board that cannot be opened.

  This hardware is potted and PoE-powered: no USB, no button, and the Ethernet cable is
  also the power cable. Its real deployments are venues with no WiFi network at all. The
  radio is the one heat source the firmware controls -- a soft-AP has to stay awake to
  beacon (ESP-IDF power save is station-only), so "AP open" means +15-20 C on the die --
  and the access point is a rescue path, not a feature. Hence four rules, applied every
  loop from the current facts rather than from remembered intent:

    1. WiFi up                         -> AP closed, radio sleeps. The normal state.
    2. WiFi lost, or absent at boot    -> AP open for AP_WINDOW_MS, long enough to join
                                          and read /netlog; stays while someone is on it.
    3. Window over, WiFi still down    -> AP closed, WiFi retried every WIFI_RETRY_MS,
                                          radio off between attempts (disconnected-state
                                          power management). Ethernet is the way in.
    4. No Ethernet address and no WiFi -> AP stays open: the only way in. On PoE this
                                          means a bench, not a venue.

  Plus: {"wifi":{"ap":true}} on /json/state -- WLED's existing key -- opens a window on
  demand (over Ethernet, to hand a phone a path), {"wifi":{"ap":false}} closes it. "AP always" in the WiFi settings is honoured as
  an always-true rule 4. Every open and close is a netlog entry with its reason.

  WLED_AP_RESCUE also means WiFi stays up alongside Ethernet; upstream turns WiFi off
  when Ethernet connects. Every place the flag changes shared code:
    wled.cpp          initConnection() keeps the AP alive across reconnect attempts and
                      leaves retries and radio sleep to this file; handleConnection()
                      compiles out upstream's AP/retry branches, but its "newly connected"
                      block still binds mDNS, OTA and friends when a link comes up.
    network.cpp       WiFiEvent() neither turns WiFi off on Ethernet link-up nor judges
                      WiFi drops itself.
    wifi_monitor.cpp  WiFi drop detection per interface (event task). The automatic
                      transmit power there has its own flag, WLED_ENABLE_AUTO_TX_POWER.
    cfg.cpp, json.cpp the AP behaviour setting is restricted, and {"wifi":{"ap":...}} is
                      routed here.
*/

static constexpr unsigned long AP_WINDOW_MS            = 5UL * 60 * 1000;  // rule 2
static constexpr unsigned long WIFI_RETRY_MS           = 10UL * 1000;      // rule 3: between attempts, counted from the previous attempt's failure
static constexpr unsigned long WIFI_ATTEMPT_TIMEOUT_MS = 30UL * 1000;      // an attempt with no verdict by then is abandoned and retried

static bool          booted       = false;
static bool          wifiWasUp    = false;
static bool          windowArmed  = false;   // rule 2 / on-demand window is running
static unsigned long windowStart  = 0;
static uint8_t       windowReason = AP_REASON_BOOT;
static uint8_t       closeReason  = AP_REASON_WINDOW_OVER;   // why the AP will close once nobody is on it
static uint8_t       clientsSeen  = 0;
static bool          requestPending = false, requestOpen = false;

static void openAp(uint8_t reason)
{
  WLED::instance().initAP();
  netlogAdd(NL_AP_OPEN, apChannel, reason);
  DEBUG_PRINTF_P(PSTR("Rescue AP opened (reason %u).\n"), (unsigned)reason);
}

static void closeAp(uint8_t reason)
{
  apActive = false;   // before the driver call, so its AP-stop event is logged as requested
  netlogAdd(NL_AP_CLOSE, 0, reason);
  dnsServer.stop();
  WiFi.softAPdisconnect(true);
  DEBUG_PRINTF_P(PSTR("Rescue AP closed (reason %u).\n"), (unsigned)reason);
}

static void armWindow(unsigned long now, uint8_t reason)
{
  windowArmed = true; windowStart = now; windowReason = reason;
}

static void disarmWindow(uint8_t reason)
{
  windowArmed = false; closeReason = reason;
}

// Modem sleep follows the AP: on whenever the AP is closed and the user allows it. The
// cost is latency on incoming packets (ping ~180 ms at the router's DTIM); realtime data
// arrives over Ethernet on this rig, so that is fine.
static void applyRadioSleep()
{
  static int8_t applied = -1;
  const bool wantSleep = !apActive && !noWifiSleep;
  if ((int8_t)wantSleep == applied) return;
  applied = wantSleep;
  netlogAdd(NL_SLEEP, wantSleep);
  WiFi.setSleep(wantSleep);
}

// One WiFi connection attempt, when the previous one has concluded. Never while a phone
// is on the AP (an attempt retunes the radio under it) or while realtime data is flowing
// (a scan stalls the pixel loop; a dropped frame costs more than a late rejoin).
static void retryWifi(unsigned long now, uint8_t apClients)
{
  if (apClients || realtimeMode != REALTIME_MODE_INACTIVE) return;
  // A failure counts only if nothing has associated since: the driver retries a failed
  // first attempt by itself, and interrupting that association mid-DHCP (measured: an
  // ASSOC_LEAVE at 13 s, 4 s after associating) just restarts the clock.
  const bool failed    = (long)(wifiLastFailureMs() - lastReconnectAttempt) >= 0 && (long)(wifiLastFailureMs() - wifiLastAssociatedMs()) > 0;
  const bool abandoned = now - lastReconnectAttempt >= WIFI_ATTEMPT_TIMEOUT_MS;
  if (!(failed || abandoned) || now - lastReconnectAttempt < WIFI_RETRY_MS) return;
  selectedWiFi = findWiFi();
  WLED::instance().initConnection(false);   // keep the station interface: a full reset every 10 s is a WIFI_OFF race (see initConnection)
}

void rescueNetworkRequestAp(bool open)
{
  requestPending = true; requestOpen = open;
}

unsigned rescueNetworkApWindowSeconds() { return AP_WINDOW_MS / 1000; }

void rescueNetworkHandle(unsigned long now, uint8_t apClients)
{
  const bool wifiUp         = WLEDNetwork.isWiFiUp();
  const bool ethUp          = WLEDNetwork.isEthernet();
  const bool wifiConfigured = WLED_WIFI_CONFIGURED;
  const bool always         = apBehavior == AP_BEHAVIOR_ALWAYS;

  // --- facts that change the window -------------------------------------------------
  if (!booted) {
    booted = true;
    if (!wifiUp) armWindow(now, AP_REASON_BOOT);
  }
  if (wifiUp && !wifiWasUp) {              // WiFi came up: rule 1 (a requested window is the user's call and stays)
    if (windowReason != AP_REASON_REQUESTED) disarmWindow(AP_REASON_WIFI_UP);
    interfacesInited = false;              // "newly connected" block rebinds mDNS/OTA; nothing else re-runs it with Ethernet already up
  }
  if (!wifiUp && wifiWasUp) armWindow(now, AP_REASON_WIFI_LOST);   // rule 2
  wifiWasUp = wifiUp;

  if (requestPending) {
    requestPending = false;
    if (requestOpen) armWindow(now, AP_REASON_REQUESTED);
    else disarmWindow(AP_REASON_REQUESTED);
  }
  if (windowArmed && now - windowStart >= AP_WINDOW_MS && apClients == 0) disarmWindow(AP_REASON_WINDOW_OVER);   // rule 3; a client extends it

  // A phone joining the AP pauses the WiFi search so the radio stays on the AP's channel;
  // the search resumes by itself once the phone leaves (retryWifi() gates on apClients).
  if (apClients && !clientsSeen && !wifiUp && wifiConfigured) WiFi.disconnect();
  clientsSeen = apClients;

  // --- desired AP state, from the facts -------------------------------------------------
  const bool wantAp = always                      // "AP always" setting
                   || (!wifiUp && !ethUp)         // rule 4
                   || windowArmed                 // rule 2 and on-demand
                   || (apActive && apClients);    // someone is using it: never close under them

  if (wantAp && !apActive)      openAp(always ? AP_REASON_ALWAYS : windowArmed ? windowReason : AP_REASON_NO_NETWORK);
  else if (!wantAp && apActive) closeAp(closeReason);

  applyRadioSleep();

  if (!wifiUp && wifiConfigured) retryWifi(now, apClients);
}
// AI: end
#endif
